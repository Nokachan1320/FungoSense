//DADOS:
char ssid[] = ""; // nome da rede wifi
char pass[] = ""; //senha do wifi
#define BLYNK_TEMPLATE_ID           "" // id do template
#define BLYNK_TEMPLATE_NAME         "" // nome do template
#define BLYNK_AUTH_TOKEN            "" // token do blynk
float tmaxf = 28; // escolha a temperatura que a ventilação vai ligar caso seja reiniciado
int refg = 1; // escolha de 1 a 0 que vai definir se a ventilação vai está liga caso seja reiniciado






/* Comment this out to disable prints and save space */
#include <heltec.h>
#include <BlynkSimpleEsp32.h>
#include <WiFi.h>
#include <WiFiClient.h>
#include <DHT.h>
#include <Wire.h>

int relayPin = 17; // Pino do relé
int blynkldr = 400; // sensor de luz padrão pós reinicio
#define BLYNK_PRINT Serial
#define DHTPIN 16 // Pino de conexão do sensor DHT11
#define DHTTYPE DHT11 // Tipo do sensor DHT (DHT11 neste caso)
DHT dht(DHTPIN, DHTTYPE);
BlynkTimer timer;

#define OLED_WIDTH 128
#define OLED_HEIGHT 64

void setup() {
  Serial.begin(115200); // Inicializa a comunicação serial
  
  //Inicio:

  pinMode(relayPin, OUTPUT);
  digitalWrite(relayPin, LOW);

  Heltec.begin(true /* DisplayEnable */, false /* LoRaEnable */, true /* SerialEnable */);
  Heltec.display->init();
  Heltec.display->clear();

  int centerbeginX = Heltec.display->width() / 2;
  int centerbeginY = Heltec.display->height() / 2;
  int radiusbegin = 20;

  Heltec.display->clear();
  Heltec.display->drawCircle(centerbeginX, centerbeginY, radiusbegin);
  Heltec.display->display();
  delay(1000);

  Heltec.display->clear();
  const unsigned char image1[] = {
// 'espacoslogoblack', 128x64px
0x00, 0x00, 0x00, 0x00, 0x00, 0x00, 0x00, 0x00, 0x00, 0x00, 0x00, 0x00, 0x00, 0x00, 0x00, 0x00, 
0x00, 0x00, 0x00, 0x00, 0x00, 0x00, 0x00, 0x00, 0x00, 0x00, 0x00, 0x00, 0x00, 0x00, 0x00, 0x00, 
0x00, 0x00, 0x00, 0x00, 0x00, 0x00, 0x00, 0x00, 0x00, 0x00, 0x00, 0x00, 0x00, 0x00, 0x00, 0x00, 
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0x00, 0x00, 0x00, 0x00, 0x00, 0x00, 0x00, 0x00, 0x00, 0x00, 0x00, 0x00, 0x00, 0x00, 0x00, 0x00
  };
  const unsigned char image2[] = {
// 'fungosenseblacj', 128x64px
0x00, 0x00, 0x00, 0x00, 0x00, 0x00, 0x00, 0x00, 0x00, 0x00, 0x00, 0x00, 0x00, 0x00, 0x00, 0x00, 
0x00, 0x00, 0x00, 0x00, 0x00, 0x00, 0x00, 0x00, 0x00, 0x00, 0x00, 0x00, 0x00, 0x00, 0x00, 0x00, 
0x00, 0x00, 0x00, 0x00, 0x00, 0x00, 0x00, 0x00, 0x00, 0x00, 0x00, 0x00, 0x00, 0x00, 0x00, 0x00, 
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0x00, 0x00, 0x00, 0x00, 0x00, 0x00, 0x00, 0x00, 0x00, 0x00, 0x00, 0x00, 0x00, 0x00, 0x00, 0x00
  };
  Heltec.display->drawXbm(0, 0, OLED_WIDTH, OLED_HEIGHT, image1);
  Heltec.display->display();
  delay(3000);
  Heltec.display->clear();
  
  Heltec.display->drawXbm(0, 0, OLED_WIDTH, OLED_HEIGHT, image2);
  Heltec.display->display();

  delay(2000);
  dht.begin(); // Inicializa o sensor DHT11
          
  timer.setInterval(500L, sensor);

  Blynk.begin(BLYNK_AUTH_TOKEN, ssid, pass);
  //leitura de status de conexão
        if (WiFi.status() == WL_CONNECTED) {
          Heltec.display->clear();
          Heltec.display->setFont(ArialMT_Plain_10);
          Heltec.display->setTextAlignment(TEXT_ALIGN_LEFT);
          Heltec.display->drawString(0,0, "wifi conectado a " + String(ssid));
          Heltec.display->display();
          delay(1000);
        } 
}

void loop() {
  Blynk.run();
  timer.run();

}

void sensor(){
  while(true){
  delay(2000); // Intervalo de leitura dos dados (2 segundos neste caso)

  int h = dht.readHumidity(); // Lê a umidade do sensor
  float t = dht.readTemperature(); // Lê a temperatura do sensor em graus Celsius

  Heltec.begin(true /* DisplayEnable */, false /* LoRaEnable */, true /* SerialEnable */);
  Heltec.display->clear();
  Heltec.display->setFont(ArialMT_Plain_10);
  Heltec.display->setTextAlignment(TEXT_ALIGN_LEFT);
  Heltec.display->drawString(0,0, "temperatura: "+ String(t) + "°c");
  Heltec.display->drawString(0,10, "umidade: "+ String(h) + "%");
  Heltec.display->display();

  Serial.print("Umidade: ");
  Serial.print(h);
  Serial.print("%\t"); // Tabulação
  Serial.print("Temperatura: ");
  Serial.print(t);
  Serial.println("°C");
  Serial.print("temperatura maxima definida: ");
  Serial.print(tmaxf);
  Serial.println(" °C");

  Blynk.virtualWrite(V6, t);
  Blynk.virtualWrite(V5, h);

  if (refg ==1){
    Heltec.display->drawString(0,40, "refrigeração ligada.");
    Heltec.display->drawString(0,30, "tempmax definido: " + String(tmaxf) + "°c");
    Heltec.display->drawString(0,20, "_________________________________ ");
    Heltec.display->display();

    if(t >= tmaxf){
      digitalWrite(relayPin, HIGH);
    }
    else{
      digitalWrite(relayPin, LOW);
    }
  }
  if (refg ==0){
    digitalWrite(relayPin, LOW);
  }

    int ldrValue = analogRead(32);
    Serial.println(ldrValue);

    Heltec.display->drawString(0,20, "luz ambiente: " + String(ldrValue));
    Heltec.display->display();

  if(ldrValue < blynkldr){
    Heltec.display->drawString(0,50, "luz abaixo de: " + String(blynkldr));
    Heltec.display->display();
  }

  if(ldrValue == blynkldr){
    Heltec.display->drawString(0,50, "luz entre: " + String(blynkldr));
    Heltec.display->display();
  }
  if(ldrValue > blynkldr){
    Heltec.display->drawString(0,50, "luz cima de: " + String(blynkldr));
    Heltec.display->display();
  }
  Blynk.virtualWrite(V2, ldrValue);
}
}

BLYNK_WRITE(V0) { //interruptor de refrigeração
  int valuev0 = param.asInt();
refg = valuev0;
}

BLYNK_WRITE(V1) { //escolha de temperatura
  float valuev1 = param.asInt();
tmaxf = valuev1;
}
